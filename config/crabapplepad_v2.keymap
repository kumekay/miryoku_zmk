// SPDX-FileCopyrightText: 2024 Sergei Silnov
// SPDX-License-Identifier: MIT

#include "../miryoku/custom_config.h"
#include "../miryoku/mapping/42/crabapplepad.h"
#include "../miryoku/miryoku.dtsi"
